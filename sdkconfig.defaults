## sdkconfig.defaults
```kconfig
# CONFIG_IDF_TARGET="esp32"
CONFIG_IDF_TARGET="esp32s2"
# CONFIG_IDF_TARGET="esp32c3"

CONFIG_TINYUSB=y
CONFIG_TINYUSB_CDC_ENABLED=y
CONFIG_TINYUSB_DEBUG_LEVEL=0
CONFIG_TINYUSB_DESC_SERIAL_STRING="0"

CONFIG_APP_PROJECT_VER_FROM_CONFIG=y
CONFIG_APP_PROJECT_VER="0.0.1"

CONFIG_PARTITION_TABLE_CUSTOM=y
CONFIG_PARTITION_TABLE_CUSTOM_FILENAME="partitions_t.csv"
CONFIG_PARTITION_TABLE_OFFSET=0x8000
CONFIG_FREERTOS_UNICORE=y
CONFIG_FREERTOS_ASSERT_ON_UNTESTED_FUNCTION=n
CONFIG_FREERTOS_ASSERT_FAIL_ABORT=n
CONFIG_FREERTOS_ASSERT_DISABLE=y
CONFIG_ESP_TASK_WDT=n
CONFIG_LWIP_LOCAL_HOSTNAME="SolarBattery"
CONFIG_ESPTOOLPY_FLASHSIZE_4MB=y

CONFIG_APP_WIFI_USE_PROVISIONING=y
CONFIG_APP_WIFI_CRED_SOURCE=1
CONFIG_APP_WIFI_USE_UNIFIED_PROVISIONING=y
CONFIG_APP_WIFI_PROVISIONING_TYPE=1
CONFIG_APP_WIFI_PROV_SHOW_QR=y
CONFIG_APP_WIFI_PROV_TRANSPORT_SOFTAP=y
CONFIG_APP_WIFI_PROV_TRANSPORT=1

CONFIG_COMPILER_OPTIMIZATION_PERF=y

CONFIG_OTA_ALLOW_HTTP=y
CONFIG_FIRMWARE_UPGRADE_URL="https://raw.githubusercontent.com/AramVartanyan/otafw/master/sbatt.bin"

CONFIG_ESP32_ULP_COPROC_ENABLED=y
CONFIG_ESP32_ULP_COPROC_RESERVE_MEM=512

# ESP32S2-specific config
CONFIG_ESP32S2_ULP_COPROC_ENABLED=y
CONFIG_ESP32S2_ULP_COPROC_RESERVE_MEM=2048
# CONFIG_ESP32S2_ULP_COPROC_RISCV=y
CONFIG_ESP32S2_TIME_SYSCALL_USE_RTC_FRC1=y
CONFIG_ESP32S2_RTC_CLK_SRC_INT_RC=y

# LVGL configuration
#

CONFIG_LV_USE_USER_DATA=y

CONFIG_LV_COLOR_DEPTH_1=y
CONFIG_LV_THEME_MONO=y
CONFIG_LV_THEME_DEFAULT_INIT_MONO=y
CONFIG_LV_DISP_DEF_REFR_PERIOD=500

CONFIG_LV_TFT_DISPLAY_USER_CONTROLLER_SSD1680=y
CONFIG_LV_HOR_RES_MAX=128
CONFIG_LV_VER_RES_MAX=296
CONFIG_LV_DPI=112
CONFIG_LV_DISPLAY_ORIENTATION_LANDSCAPE=y

#
# Display Pin Assignments
#
CONFIG_LV_DISP_SPI_MOSI=38
# CONFIG_LV_DISPLAY_USE_SPI_MISO is not set
CONFIG_LV_DISP_SPI_CLK=37
CONFIG_LV_DISPLAY_USE_SPI_CS=y
CONFIG_LV_DISP_SPI_CS=36
CONFIG_LV_DISPLAY_USE_DC=y
CONFIG_LV_DISP_PIN_DC=35
CONFIG_LV_DISP_USE_RST=y
CONFIG_LV_DISP_PIN_RST=34
CONFIG_LV_DISP_PIN_BUSY=33

CONFIG_LV_DISP_BACKLIGHT_OFF=y
```
